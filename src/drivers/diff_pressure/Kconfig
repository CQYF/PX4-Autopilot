## src/drivers/diff_pressure/Kconfig
```kconfig
menuconfig DRIVERS_DIFF_PRESSURE
	bool "diff_pressure"
	default n
	---help---
		Enable support for diff_pressure
```

## src/drivers/multipressure/Kconfig
```kconfig
menuconfig DRIVERS_MULTIPRESSURE
	bool "multipressure"
	default n
	---help---
		Enable support for multipressure
```

## src/drivers/water_level/Kconfig
```kconfig
menuconfig DRIVERS_WATER_LEVEL
	bool "water_level"
	default n
	---help---
		Enable support for water_level
```

## src/modules/slide_estimator/Kconfig
```kconfig
menuconfig MODULES_SLIDE_ESTIMATOR
	bool "slide_estimator"
	default n
	---help---
		Enable support for slide_estimator
```

## src/modules/speed_estimator/Kconfig
```kconfig
menuconfig MODULES_speed_estimator
	bool "speed_estimator"
	default n
	---help---
		Enable support for speed_estimator
```
