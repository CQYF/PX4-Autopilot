## src/modules/depth_fusion/Kconfig
```kconfig
menuconfig MODULES_DEPTH_FUSION
	bool "depth_fusion"
	default n
	---help---
		Enable support for depth_fusion
```

## src/modules/hydro_allocator/Kconfig
```kconfig
menuconfig MODULES_HYDRO_ALLOCATOR
	bool "hydro_allocator"
	default n
	---help---
		Enable support for hydro_allocator
```

## src/modules/vtrack/Kconfig
```kconfig
menuconfig MODULES_VTRACK
	bool "vtrack"
	default n
	---help---
		Enable support for vtrack
```

## src/modules/wacm_att_control/Kconfig
```kconfig
menuconfig MODULES_WACM_ATT_CONTROL
	bool "wacm_att_control"
	default n
	---help---
		Enable support for wacm_att_control
```

## src/modules/wacm_control/Kconfig
```kconfig
menuconfig MODULES_WACM_CONTROL
	bool "wacm_control"
	default n
	---help---
		Enable support for wacm_control
```

## src/modules/wacm_rate_control/Kconfig
```kconfig
menuconfig MODULES_WACM_RATE_CONTROL
	bool "wacm_rate_control"
	default n
	---help---
		Enable support for wacm_rate_control
```
